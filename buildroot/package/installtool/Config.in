## buildroot/package/installtool/Config.in
```kconfig
config BR2_PACKAGE_INSTALLTOOL
        bool "installtool"
    ### build dependencies
    select BR2_PACKAGE_QT
    select BR2_PACKAGE_QT_QTPNG
    select BR2_PACKAGE_QT_GFX_LINUXFB
    select BR2_PACKAGE_QT_GFX_VNC
    select BR2_PACKAGE_QT_QTFREETYPE
    select BR2_PACKAGE_QT_SYSTEMZLIB
    select BR2_PACKAGE_QT_MOUSE_PC
    select BR2_PACKAGE_QT_KEYBOARD_TTY
    select BR2_PACKAGE_QJSON
        help
          recovery GUI 
```

## buildroot/package/p7zip/Config.in
```kconfig
config BR2_PACKAGE_P7ZIP
	bool "p7zip"
	help
	  p7zip is a quick port of 7.exe nad 7xza.exe
	   (command line version of 7-zip, see http://www.7-zip.org) for Unix.

	  7-Zip is a file archiver with highest compression ratio.

	  http://sourceforge.net/projects/p7zip
```

## buildroot/package/winiot/Config.in
```kconfig
config BR2_PACKAGE_WINIOT
        bool "winiot"
    select BR2_PACKAGE_INSTALLTOOL
        help
          Windows IoT helper
```
